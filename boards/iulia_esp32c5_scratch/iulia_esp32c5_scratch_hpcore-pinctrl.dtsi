#include <zephyr/dt-bindings/pinctrl/esp32c5-pinctrl.h>

&pinctrl {
    uart0_default: uart0_default {
        group1 {
            pinmux = <UART0_TX_GPIO11>;
            output-high;
        };

        group2 {
            pinmux = <UART0_RX_GPIO12>;
            bias-pull-up;
        };
    };
};