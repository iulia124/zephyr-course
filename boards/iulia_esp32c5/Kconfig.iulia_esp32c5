## boards/iulia_esp32c5/Kconfig.iulia_esp32c5
```kconfig
# Iulia ESP32C5 board configuration

# Copyright (c) 2026 Espressif Systems (Shanghai) Co., Ltd.
# SPDX-License-Identifier: Apache-2.0

config BOARD_IULIA_ESP32C5
    select SOC_ESP32_C5_WROOM_1_N8R4
    select SOC_ESP32C5_HPCORE if BOARD_IULIA_ESP32C5_ESP32C5_HPCORE
    select SOC_ESP32C5_LPCORE if BOARD_IULIA_ESP32C5_ESP32C5_LPCORE
```

## boards/iulia_esp32c5/board.yml
```yaml
board:
  name: iulia_esp32c5
  full_name: ESP32-C5-DevKitC-1
  vendor: espressif
  socs:
  - name: esp32c5
```

## boards/iulia_esp32c5_scratch/Kconfig.defconfig
```kconfig
if BOARD_IULIA_ESP32C5_SCRATCH

config HEAP_MEM_POOL_ADD_SIZE_BOARD
    int
    default 4096 if BOARD_IULIA_ESP32C5_SCRATCH_ESP32C5_HPCORE

endif
```

## boards/iulia_esp32c5_scratch/Kconfig.iulia_esp32c5_scratch
```kconfig
config BOARD_IULIA_ESP32C5_SCRATCH
    select SOC_ESP32_C5_WROOM_1_N8R4
    select SOC_ESP32C5_HPCORE if BOARD_IULIA_ESP32C5_SCRATCH_ESP32C5_HPCORE
```

## boards/iulia_esp32c5_scratch/board.yml
```yaml
board:
  name: iulia_esp32c5_scratch
  full_name: Iulia ESP32-C5 Scratch Board
  vendor: espressif
  socs:
    - name: esp32c5
```

## boards/iulia_esp32c5_scratch/iulia_esp32c5_scratch_hpcore_defconfig
```kconfig
CONFIG_CONSOLE=y
CONFIG_SERIAL=y
CONFIG_UART_CONSOLE=y
CONFIG_GPIO=y

CONFIG_FLASH_SIZE=4096

CONFIG_ESPTOOLPY_FLASHMODE_DIO=y
CONFIG_ESPTOOLPY_FLASHFREQ_40M=y
CONFIG_ESPTOOLPY_FLASHSIZE_4MB=y
```

## modules/iulia_led_sensor/drivers/led_sensor/Kconfig
```kconfig
menuconfig IULIA_LED_SENSOR
    bool "Iulia LED sensor driver"
    default y
    depends on DT_HAS_IULIA_LED_SENSOR_ENABLED
    select SENSOR
    select LED_STRIP
    help
      Enable the custom sensor driver controlling the on-board RGB LED.
```

## modules/iulia_led_sensor/dts/bindings/sensor/iulia,led-sensor.yaml
```yaml
description: Iulia on-board LED sensor driver

compatible: "iulia,led-sensor"

include: base.yaml

properties:
  led-strip:
    type: phandle
    required: true
    description: LED strip device controlled by this sensor driver
```
